## boards/shields/nice_view_screen/Kconfig.defconfig
```kconfig
# Copyright (c) 2023 The ZMK Contributors
# SPDX-License-Identifier: MIT

if SHIELD_NICE_VIEW_SCREEN

config LV_Z_VDB_SIZE
    default 100

config LV_DPI_DEF
    default 161

config LV_Z_BITS_PER_PIXEL
    default 1

choice LV_COLOR_DEPTH
    default LV_COLOR_DEPTH_1
endchoice

endif # SHIELD_NICE_VIEW_SCREEN
```

## boards/shields/nice_view_sno1/Kconfig.defconfig
```kconfig
# Copyright (c) 2025 The ZMK Contributors
# SPDX-License-Identifier: MIT

if SHIELD_NICE_VIEW_SNO1

config LV_Z_VDB_SIZE
    default 100

config LV_Z_MEM_POOL_SIZE
    default 8192

config SYSTEM_WORKQUEUE_STACK_SIZE
    default 4096

choice ZMK_DISPLAY_WORK_QUEUE
    default ZMK_DISPLAY_WORK_QUEUE_DEDICATED
endchoice

choice ZMK_DISPLAY_STATUS_SCREEN
    default ZMK_DISPLAY_STATUS_SCREEN_CUSTOM
endchoice

config ZMK_DISPLAY_STATUS_SCREEN_CUSTOM
    imply NICE_VIEW_SNO1_STATUS

config NICE_VIEW_SNO1_STATUS
    bool "Custom `sno1` nice!view status widget"
    select LV_USE_IMAGE
    select LV_USE_CANVAS
    select LV_USE_ANIMIMG

config NICE_VIEW_WIDGET_INVERTED
    bool "Invert custom status widget colors"


config TRACKED_PROFILE_COUNT
    int "max number of BLE profiles to show"
    default 5

config LOCK_ICONS_TIMEOUT
    int "duration to keep indicator icon after deactivation (ms)"
    default 5000

config SPLASH_SCREEN_TIMEOUT
    int "duration to show the splash screen for at startup (ms)"
    default 3000

config USE_BT_ICON
    bool "use BT icon instead of wireless icon"

config DISPLAY_DEMO_MODE
    bool "cycle synthetic display states"

config WIDGET_LAYOUT_TRANSITION
    bool "use smooth animated trasition to move widgets"
    default y

config PRINT_LVGL_SNAPSHOTS
    bool "print LVGL snapshots to stdout"
    select LV_USE_SNAPSHOT
    depends on BOARD_NATIVE_SIM
    default y

endif # SHIELD_NICE_VIEW_SNO1
```

## boards/shields/nice_view_sno1/Kconfig.shield
```kconfig
# Copyright (c) 2025 The ZMK Contributors
# SPDX-License-Identifier: MIT

config SHIELD_NICE_VIEW_SNO1
    def_bool $(shields_list_contains,nice_view_sno1)
```
